## west.yml
```yaml
manifest:
  projects:
    - name: zmk
      url: https://github.com/zmkfirmware/zmk
      revision: main
    - name: zmk-custom-functions-lib
      url: https://github.com/nothingfortune/zmk-custom-functions-lib
      revision: main
      path: libs/zmk-custom-functions-lib
```
